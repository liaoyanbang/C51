/***************
author：zc
description： 蜂鸣器播放音乐 天空之城
			  晶振11.0592Mhz
			  实现方法：
			  		while(1)循环中生成音调方波；
					定时器1记录每个音调的时长并切换音调
****************/

#include "music.h"
unsigned int tones[]=   			 //C调音调
{
3816,3401,3030,2865,2551,2272,2024,	 //低音
1912,1703,1517,1432,1275,1136,1012,	 //中音
965, 851, 758, 715, 605, 538, 466	 //高音
};

unsigned char code sky[]={			 //谱子
//格式： 音调， 音度， 拍数
//例： 4，1，1 //音调fa，中音，时长半拍
//0代表空音
0,0,2,
0,0,2,
0,0,2,
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6,1,2,
};

sbit	Buzzer=P3^7;	             //定义buzzer引脚

unsigned char s=0, t_tone=0;	     //s用作定时器计时， t_tone保存音调时长
unsigned int  tone=0;			     //tone保存音调，
char *tone_p=sky;					 //指针指向要播放的曲目



void time_init( void )
{
	TMOD|=0x10;						 //使用定时器1
	TH1=(65536-65000)/256;			 //装初值
	TL1=(65536-65000)%256;
	EA =  1;						 //开中断，打开定时器开关
	ET1 = 1;
	TR1 = 1;
}

void timer1( void ) interrupt 3		 //定时器1 中断
{
	TH1=(65536-50000)/256;			 //装初值
	TL1=(65536-50000)%256;
	s++;
	if(s>=4*t_tone)					 //一个音节播放的时间，这里可以通过调t_tone前的系数可以改变时长
	{
		s=0;						 //讲计时器清零
		if((*tone_p)!=0)			 //如果音不是0
			tone = tones[*tone_p+7*(*(tone_p+1))-1];  //赋值音调
		else 
			tone = 0;			     //关了蜂鸣器
		t_tone = *(tone_p+2);		 //取时间啊
		tone_p+=3;					 //移动指针
		delay_ms(100);				 //延时一下，不延时特别难听
	}
} 


void play_tone(unsigned int tone)	 //播音调函数，就是方波发生器
{

		Buzzer=!Buzzer;				 
		delay_us(tone);		
}

void delay_ms(unsigned int t)		 //毫秒延时12MHz下
{
	unsigned int i=0;
	while(t--)
		for(i=0;i<75;i++);
}

void delay_us(unsigned int t)		 //us延时 12MHz下
{
	t/=10;
	for(t;t;t--);
}


